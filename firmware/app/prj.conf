## CMakeLists.txt
```
# Copyright 2026 NXP / product
#
# SPDX-License-Identifier: BSD-3-Clause

cmake_minimum_required(VERSION 3.22.0)

include(${SdkRootDirPath}/cmake/extension/mcux.cmake)

project(mcxn947_secure_ota LANGUAGES C CXX ASM PROJECT_BOARD_PORT_PATH ${board_root}/${board}/ota_examples/ota_mcuboot_server/enet)

include(${SdkRootDirPath}/CMakeLists.txt)

mcux_add_source(
    SOURCES enet/network_cfg.h
            enet/app.h
            frdmmcxn947/FreeRTOSConfigBoard.h
            network_enet/init_enet.c
            network_enet/lwipopts.h
            ota_mcuboot_server/FreeRTOSConfig.h
            src/main.c
            src/led_task.c
            src/hello_service.c
            src/update_service.c
            src/diagnostics.c
            src/mtls_socket.c
            src/qa_stream.c
            src/runhours_journal.c
            src/runhours_crypto.c
            src/runhours_keystore.c
            src/runhours_task.c
            src/runhours_stress.c
            src/flash_arbiter.c
            inc/app_config.h
            inc/diagnostics.h
            inc/led_task.h
            inc/hello_service.h
            inc/update_service.h
            inc/mtls_socket.h
            inc/qa_stream.h
            inc/memory_layout.h
            inc/runhours_format.h
            inc/runhours_journal.h
            inc/runhours_crypto.h
            inc/runhours_keystore.h
            inc/runhours_task.h
            inc/runhours_stress.h
            inc/flash_arbiter.h
            inc/flash_range_guard.h
    )

mcux_add_include(
    INCLUDES enet
             flash_partitioning
             frdmmcxn947
             mcuboot_opensource
             network_enet
             ota_mcuboot_server
             inc
             src
             security
             ${SdkRootDirPath}/middleware/mbedtls3x/library
)

# LEAN_PROD_TEST: product USER_CONFIG overlay (allow-list prune). BASELINE omits this.
if(DEFINED LEAN_PROD AND LEAN_PROD)
    mcux_add_macro(
        CC "-DMBEDTLS_USER_CONFIG_FILE=\\\"mbedtls_product_user_config.h\\\""
    )
    message(STATUS "LEAN_PROD: MBEDTLS_USER_CONFIG_FILE=mbedtls_product_user_config.h")
    # Size build: -Os + GC (do not reduce TLS/lwIP buffers).
    mcux_add_armgcc_configuration(
        TARGETS release
        CC "-Os -ffunction-sections -fdata-sections"
        CX "-Os -ffunction-sections -fdata-sections"
        LD "-Wl,--gc-sections"
    )
endif()

# Build-only 512 KiB layout (no CMPA write). Pair with lean for size proof.
# Linker script swap happens after reconfig.cmake (below) so remove wins.
if(DEFINED APP_FLASH_LAYOUT_512K AND APP_FLASH_LAYOUT_512K)
    mcux_add_macro(CC "-DAPP_FLASH_LAYOUT_512K=1")
    message(STATUS "APP_FLASH_LAYOUT_512K=1 (build-only; CMPA remap unchanged until owner gate)")
endif()

# QA-only 4 Hz run-hours endurance (not for production release).
if(DEFINED APP_RH_ENDURANCE_TEST AND APP_RH_ENDURANCE_TEST)
    mcux_add_macro(CC "-DAPP_RH_ENDURANCE_TEST=1")
    message(STATUS "APP_RH_ENDURANCE_TEST=1 (QA 4Hz journal endurance — NOT FOR PRODUCTION)")
endif()

mcux_add_source(
    SOURCES flash_partitioning/flash_partitioning.c
            flash_partitioning/flash_partitioning.h
            mcuboot_opensource/sblconfig.h
)

mcux_add_armgcc_configuration(
    TARGETS debug
    CC "-g1"
    CX "-g1"
)

mcux_add_mcux_configuration(
    TARGETS debug
    CC "-Og"
    CX "-g3"
)

# Default product macros come from tools/mcxn.py EXTRA_CFLAGS (V1/V2).
mcux_add_macro(
    CC "-DMCUBOOT_APPLICATION=1\
       -DMCUBOOT_OTA_SB3_SUPPORT=1\
       -DUSE_RTOS=1\
       -DPRINTF_ADVANCED_ENABLE=1\
       -DMBEDTLS_THREADING_C\
       -DMBEDTLS_THREADING_ALT"
)

mcux_add_source(
    BASE_PATH C:/mcxn-secrets/mtls/generated
    SOURCES mtls_creds.c
)

# NXP SB3 ROM path (same sources as ota_mcuboot_basic board reconfig).
mcux_add_source(
    BASE_PATH ${SdkRootDirPath}
    SOURCES examples/ota_examples/_common/sb3_api/sb3_api.h
            examples/ota_examples/_common/sb3_api/sb3_api_mcxn10.c
)

mcux_add_include(
    BASE_PATH ${SdkRootDirPath}
    INCLUDES examples/ota_examples/_common/sb3_api
)

mcux_add_macro(
    TOOLCHAINS armgcc
    CC "-D_POSIX_SOURCE"
)

mcux_remove_armgcc_configuration(
    TARGETS debug
    CC "-g"
    CX "-g"
)

mcux_add_iar_configuration(
    LD "--config_def=__stack_size__=0x1000 --config_def=__heap_size__=0x10000"
)

mcux_add_mdk_configuration(
    LD "--predefine=\"-D__stack_size__=0x1000\" --predefine=\"-D__heap_size__=0x10000\""
)

# Production keeps 0x1B000. QA soak (APP_QA_STREAM) needs a larger newlib arena for
# a second mTLS session + FreeRTOS task stacks allocated via heap_3; pass -DQA_HEAP_SIZE=0x28000.
if(DEFINED QA_HEAP_SIZE)
    set(_APP_HEAP_SIZE ${QA_HEAP_SIZE})
else()
    set(_APP_HEAP_SIZE 0x1B000)
endif()
mcux_add_armgcc_configuration(
    LD "-Xlinker --defsym=__stack_size__=0x1000 -Xlinker --defsym=__heap_size__=${_APP_HEAP_SIZE}"
)

include(${SdkRootDirPath}/${board_root}/${board}/ota_examples/ota_mcuboot_server/enet/reconfig.cmake OPTIONAL)

# P3+: use NXP OTA/MCUboot slot linker (header at 0x400). For P2-only standalone
# bring-up without IFR MCUboot, temporarily include standalone_linker.cmake instead.
# include(${CMAKE_CURRENT_LIST_DIR}/standalone_linker.cmake)

# After SDK linker is registered: constrain to 512 KiB slot when requested.
if(DEFINED APP_FLASH_LAYOUT_512K AND APP_FLASH_LAYOUT_512K)
    mcux_remove_armgcc_linker_script(
        TARGETS debug release
        BASE_PATH ${SdkRootDirPath}
        LINKER ${board_root}/${board}/ota_examples/ota_linker/mcxn10_cm33_flash.ld
    )
    mcux_add_armgcc_linker_script(
        TARGETS debug release
        LINKER ${CMAKE_CURRENT_LIST_DIR}/linker/mcxn10_cm33_flash_512k.ld
    )
endif()

mcux_convert_binary(BINARY ${APPLICATION_BINARY_DIR}/${MCUX_SDK_PROJECT_NAME}.bin)
```

## prj.conf
```kconfig
# Copyright 2026 NXP / product overlay
#
# SPDX-License-Identifier: BSD-3-Clause
CONFIG_MCUX_COMPONENT_middleware.mcuboot.nxp_app_support=y
CONFIG_MCUX_COMPONENT_middleware.freertos-kernel=y
CONFIG_MCUX_COMPONENT_middleware.freertos-kernel.heap_3=y
CONFIG_MCUX_COMPONENT_middleware.freertos-kernel.extension=y
CONFIG_MCUX_COMPONENT_middleware.lwip=y
CONFIG_MCUX_COMPONENT_driver.romapi_flashiap=y
CONFIG_MCUX_COMPONENT_driver.mem_interface=y
CONFIG_MCUX_COMPONENT_utility.assert_lite=n
CONFIG_MCUX_COMPONENT_utility.assert=y
CONFIG_MCUX_COMPONENT_utility.debug_console_lite=n
CONFIG_MCUX_COMPONENT_utility.debug_console=y
CONFIG_MCUX_COMPONENT_component.serial_manager=y
CONFIG_MCUX_COMPONENT_component.serial_manager_uart=y
CONFIG_MCUX_COMPONENT_component.silicon_id=y
CONFIG_MCUX_COMPONENT_middleware.mbedtls3x=y
CONFIG_MCUX_COMPONENT_middleware.mbedtls3x.port.config=y
CONFIG_MCUX_COMPONENT_component.psa_crypto_driver.mbedtls_thread_alt=y
CONFIG_MCUX_COMPONENT_component.psa_crypto_driver.els_pkc=y
CONFIG_MCUX_COMPONENT_middleware.mbedtls3x.port.psa_crypto_config=n
CONFIG_MCUX_PRJSEG_module.board.pinmux_project_folder=y
CONFIG_MCUX_PRJSEG_project.hw_app_project_folder=y
```

## ota_mcuboot_server_enet.conf
```kconfig
# Keep default IFR MCUboot flash-remap layout metadata; do not enable main-flash-only.
# Standalone linker override is applied from standalone_linker.cmake for P2 bring-up.
CONFIG_MCUX_PRJSEG_module.board.ota_examples.mcxn.default_linker_application=n
```

## src/main.c
```c
#include "app.h"
#include "app_config.h"
#include "board.h"
#include "diagnostics.h"
#include "hello_service.h"
#include "led_task.h"
#include "mtls_socket.h"
#include "qa_stream.h"
#include "update_service.h"
#include "runhours_journal.h"
#include "runhours_task.h"
#include "flash_arbiter.h"
#if defined(APP_RH_ENDURANCE_TEST) && (APP_RH_ENDURANCE_TEST)
#include "runhours_stress.h"
#endif

#include "fsl_common.h"
#include "fsl_debug_console.h"
#include "mflash_drv.h"

#include "lwip/tcpip.h"
#include "lwip/sys.h"
#include "mcuboot_app_support.h"

#include "FreeRTOS.h"
#include "task.h"

static void confirm_image_if_testing(void)
{
    uint32_t imgstate = 0;

    if (bl_get_image_state(0, &imgstate) != kStatus_Success)
    {
        return;
    }
    if (imgstate == kSwapType_Testing)
    {
        if (bl_update_image_state(0, kSwapType_Permanent) == kStatus_Success)
        {
            PRINTF("MCUboot image confirmed (was Testing)\r\n");
        }
        else
        {
            PRINTF("MCUboot confirm failed\r\n");
        }
    }
}

int initNetwork(void);

#ifndef MAIN_THREAD_STACK
#define MAIN_THREAD_STACK 2048
#endif

static void main_thread(void *arg)
{
    (void)arg;

    diagnostics_mark_app_start();
    diagnostics_init();

    PRINTF("App %s version=%s\r\n", APP_VARIANT, APP_VERSION_STRING);
    confirm_image_if_testing();

    led_task_start();

    if (initNetwork() != 0)
    {
        PRINTF("Network init failed\r\n");
        vTaskDelete(NULL);
        return;
    }

    if (mtls_global_init() != 0)
    {
        PRINTF("mTLS init failed\r\n");
        vTaskDelete(NULL);
        return;
    }

#if defined(APP_FLASH_LAYOUT_512K)
    {
        rh_status_t rhs = rh_journal_init();
        PRINTF("rh_journal_init: %d\r\n", (int)rhs);
        if (rhs == RH_OK)
        {
#if defined(APP_RH_ENDURANCE_TEST) && (APP_RH_ENDURANCE_TEST)
            rh_stress_task_start();
#else
            runhours_task_start();
#endif
        }
    }
#endif

    hello_service_start();
    update_service_start();
    qa_stream_service_start();

    vTaskDelete(NULL);
}

int main(void)
{
    BOARD_InitHardware();
    mflash_drv_init();

    PRINTF("\r\n=== %s ===\r\n", EXAMPLE_BANNER);

    if (sys_thread_new("main", main_thread, NULL, MAIN_THREAD_STACK, DEFAULT_THREAD_PRIO) == NULL)
    {
        LWIP_ASSERT("main thread", 0);
    }

    vTaskStartScheduler();
    for (;;)
    {
    }
}
```

## inc/app_config.h
```c
#ifndef APP_CONFIG_H_
#define APP_CONFIG_H_

#ifndef APP_VARIANT
#define APP_VARIANT "V1"
#endif

#ifndef APP_VERSION_STRING
#define APP_VERSION_STRING "1.0.0"
#endif

#ifndef APP_LED_COLOR
#define APP_LED_COLOR GREEN
#endif

#ifndef APP_LED_ON_MS
#define APP_LED_ON_MS 500
#endif

#ifndef APP_LED_OFF_MS
#define APP_LED_OFF_MS 500
#endif

#ifndef APP_HELLO_REPLY
#define APP_HELLO_REPLY "Hello PC!"
#endif

#define HELLO_TCP_PORT   5000
#define UPDATE_TCP_PORT  5555
#define UPDATE_WINDOW_S  180

#define HELLO_MAX_REQ_B  128
#define HELLO_RECV_TO_MS 5000

/* P5 Ethernet SB3 — transport limits (not crypto) */
#include "memory_layout.h"
#define UPDATE_HDR_MAGIC       0x5341544Fu /* 'OTAS' LE */
#define UPDATE_HDR_VERSION     1u
#define UPDATE_HDR_SIZE_B      28u
/* Cap payload to active slot size (+ SB3 cmd overhead); 512K layout shrinks this. */
#define UPDATE_SB3_MAX_B       (APP_SLOT_SIZE + 0x40000u)
#define UPDATE_CHUNK_B         1024u
#define UPDATE_HDR_RECV_TO_MS  5000
#define UPDATE_STREAM_TO_MS    10000
#define UPDATE_OK_FLUSH_MS     200

#define EXAMPLE_BANNER "MCXN947 Secure OTA prototype"

/* Fleet network policy — override any SDK board network_cfg.h defaults */
#ifndef IP_ADDR
#define IP_ADDR "192.168.2.90"
#endif
#ifndef IP_MASK
#define IP_MASK "255.255.255.0"
#endif
#ifndef GW_ADDR
#define GW_ADDR "192.168.2.24"
#endif

#endif /* APP_CONFIG_H_ */
```

## inc/diagnostics.h
```c
#ifndef DIAGNOSTICS_H_
#define DIAGNOSTICS_H_

#include <stdint.h>

#ifdef __cplusplus
extern "C" {
#endif

void diagnostics_init(void);
const char *diagnostics_uuid_hex(void);
const uint8_t *diagnostics_uuid_bytes(void);
uint32_t diagnostics_uptime_s(void);
uint32_t diagnostics_update_window_remaining_s(void);
void diagnostics_mark_app_start(void);

/* Counters for prototype qualification */
extern volatile uint32_t g_hello_accept_count;
extern volatile uint32_t g_hello_error_count;
extern volatile uint32_t g_update_accept_count;
extern volatile uint32_t g_update_success_count;
extern volatile uint32_t g_update_failure_count;
extern volatile uint32_t g_sb3_failure_count;
extern volatile uint32_t g_link_down_count;
extern volatile uint32_t g_mtls_handshake_ok;
extern volatile uint32_t g_mtls_handshake_fail;
extern volatile uint32_t g_mtls_verify_fail;
extern volatile uint32_t g_mtls_timeout;
extern volatile uint32_t g_mtls_peer_close;
extern volatile uint32_t g_mtls_session_abort;
extern volatile uint32_t g_normal_tls_rx_bytes;
extern volatile uint32_t g_normal_tls_tx_bytes;
extern volatile uint32_t g_update_tls_rx_bytes;
extern volatile uint32_t g_update_tls_tx_bytes;

#ifdef __cplusplus
}
#endif

#endif /* DIAGNOSTICS_H_ */
```

## inc/flash_arbiter.h
```c
/*
 * Single-writer flash arbiter: OTA exclusive vs journal deferred writes.
 */
#ifndef FLASH_ARBITER_H_
#define FLASH_ARBITER_H_

#include <stdint.h>

typedef enum {
    FLASH_OWNER_NONE = 0,
    FLASH_OWNER_JOURNAL,
    FLASH_OWNER_OTA
} flash_owner_t;

void flash_arbiter_init(void);

/* Blocking take; OTA should use FLASH_OWNER_OTA. */
int flash_arbiter_acquire(flash_owner_t owner, uint32_t timeout_ms);

void flash_arbiter_release(flash_owner_t owner);

flash_owner_t flash_arbiter_owner(void);

uint32_t flash_arbiter_journal_deferred_count(void);
void flash_arbiter_note_journal_deferred(void);

#endif /* FLASH_ARBITER_H_ */
```

## inc/flash_range_guard.h
```c
/*
 * Address-range guards: OTA must stay in candidate slot; journal in runhours pools.
 */
#ifndef FLASH_RANGE_GUARD_H_
#define FLASH_RANGE_GUARD_H_

#include "memory_layout.h"

static inline int flash_guard_ota_range_ok(uint32_t addr, uint32_t len)
{
    return ml_addr_in_candidate_slot(addr, len);
}

static inline int flash_guard_runhours_range_ok(uint32_t addr, uint32_t len)
{
    return ml_addr_in_runhours(addr, len);
}

static inline int flash_guard_platform_reserve_ok(uint32_t addr, uint32_t len)
{
#if defined(APP_FLASH_LAYOUT_512K)
    if (len == 0u || (addr + len) < addr)
    {
        return 0;
    }
    const int in_a = (addr >= ML_PLATFORM_RESERVE_A) &&
                     ((addr + len) <= (ML_PLATFORM_RESERVE_A + ML_PLATFORM_RESERVE_A_SZ));
    const int in_b = (addr >= ML_PLATFORM_RESERVE_B) &&
                     ((addr + len) <= (ML_PLATFORM_RESERVE_B + ML_PLATFORM_RESERVE_B_SZ));
    return in_a || in_b;
#else
    (void)addr;
    (void)len;
    return 0;
#endif
}

static inline int flash_guard_not_security_region(uint32_t addr, uint32_t len)
{
    /* IFR / MCUboot and out-of-main-flash */
    if (addr >= ML_IFR_MCUBOOT_BASE && addr < (ML_IFR_MCUBOOT_BASE + ML_IFR_MCUBOOT_SIZE))
    {
        return 0;
    }
    if ((addr + len) < addr)
    {
        return 0;
    }
    return 1;
}

#endif /* FLASH_RANGE_GUARD_H_ */
```

## inc/hello_service.h
```c
#ifndef HELLO_SERVICE_H_
#define HELLO_SERVICE_H_

#ifdef __cplusplus
extern "C" {
#endif

void hello_service_start(void);

#ifdef __cplusplus
}
#endif

#endif /* HELLO_SERVICE_H_ */
```

## inc/led_task.h
```c
#ifndef LED_TASK_H_
#define LED_TASK_H_

#ifdef __cplusplus
extern "C" {
#endif

void led_task_start(void);

#ifdef __cplusplus
}
#endif

#endif /* LED_TASK_H_ */
```

## inc/memory_layout.h
```c
/*
 * Single source of truth for flash map (Rev B).
 * APP_FLASH_LAYOUT_512K selects 512 KiB slots + shared pools (build-only until CMPA).
 * Default: legacy 1 MiB slots matching current field remap.
 */
#ifndef MEMORY_LAYOUT_H_
#define MEMORY_LAYOUT_H_

#include <stdint.h>

#define ML_FLASH_BASE              (0x00000000u)
#define ML_FLASH_SIZE              (0x00200000u)

#define ML_IFR_MCUBOOT_BASE        (0x01008000u)
#define ML_IFR_MCUBOOT_SIZE        (0x00008000u)

#define BOOT_FLASH_ACT_APP         (0x00000000u)
#define BOOT_FLASH_CAND_APP        (0x00100000u)

#if defined(APP_FLASH_LAYOUT_512K)

#define APP_SLOT_SIZE              (0x00080000u) /* 512 KiB */

#define ML_PLATFORM_RESERVE_A      (0x00080000u)
#define ML_PLATFORM_RESERVE_A_SZ   (0x00020000u)
#define ML_RUNHOURS_POOL_A         (0x000A0000u)
#define ML_RUNHOURS_POOL_A_SZ      (0x00010000u)
#define ML_EVENT_LOG_POOL_A        (0x000B0000u)
#define ML_EVENT_LOG_POOL_A_SZ     (0x00050000u)

#define ML_PLATFORM_RESERVE_B      (0x00180000u)
#define ML_PLATFORM_RESERVE_B_SZ   (0x00020000u)
#define ML_RUNHOURS_POOL_B         (0x001A0000u)
#define ML_RUNHOURS_POOL_B_SZ      (0x00010000u)
#define ML_EVENT_LOG_POOL_B        (0x001B0000u)
#define ML_EVENT_LOG_POOL_B_SZ     (0x00050000u)

#define ML_RUNHOURS_TOTAL_SZ       (0x00020000u)
#define ML_PLATFORM_RESERVE_TOTAL  (0x00040000u)
#define ML_FLASH_REMAP_SIZE_FIELD  (15u)

#else

#define APP_SLOT_SIZE              (0x00100000u) /* 1 MiB legacy */

#endif

_Static_assert((BOOT_FLASH_CAND_APP - BOOT_FLASH_ACT_APP) == 0x00100000u, "slot bases");
_Static_assert(APP_SLOT_SIZE == 0x00080000u || APP_SLOT_SIZE == 0x00100000u, "APP_SLOT_SIZE");

#if defined(APP_FLASH_LAYOUT_512K)
_Static_assert(APP_SLOT_SIZE == 0x00080000u, "512K slots");
_Static_assert(ML_RUNHOURS_TOTAL_SZ == 0x00020000u, "128KiB journal");
_Static_assert(ML_PLATFORM_RESERVE_A >= (BOOT_FLASH_ACT_APP + APP_SLOT_SIZE), "shared after A");
_Static_assert(ML_PLATFORM_RESERVE_B >= (BOOT_FLASH_CAND_APP + APP_SLOT_SIZE), "shared after B");
#endif

static inline int ml_addr_in_candidate_slot(uint32_t addr, uint32_t len)
{
    const uint32_t lo = BOOT_FLASH_CAND_APP;
    const uint32_t hi = BOOT_FLASH_CAND_APP + APP_SLOT_SIZE;
    if (len == 0u || addr < lo || (addr + len) < addr)
    {
        return 0;
    }
    return (addr + len) <= hi;
}

static inline int ml_addr_in_runhours(uint32_t addr, uint32_t len)
{
#if defined(APP_FLASH_LAYOUT_512K)
    if (len == 0u || (addr + len) < addr)
    {
        return 0;
    }
    const int in_a =
        (addr >= ML_RUNHOURS_POOL_A) && ((addr + len) <= (ML_RUNHOURS_POOL_A + ML_RUNHOURS_POOL_A_SZ));
    const int in_b =
        (addr >= ML_RUNHOURS_POOL_B) && ((addr + len) <= (ML_RUNHOURS_POOL_B + ML_RUNHOURS_POOL_B_SZ));
    return in_a || in_b;
#else
    (void)addr;
    (void)len;
    return 0;
#endif
}

#endif /* MEMORY_LAYOUT_H_ */
```

## inc/mtls_socket.h
```c
#ifndef MTLS_SOCKET_H_
#define MTLS_SOCKET_H_

#include <stddef.h>
#include <stdint.h>

#include "mbedtls/ssl.h"

#ifdef __cplusplus
extern "C" {
#endif

#ifndef MTLS_HANDSHAKE_TIMEOUT_MS
#define MTLS_HANDSHAKE_TIMEOUT_MS 5000u
#endif

#ifndef MTLS_IO_TIMEOUT_MS
#define MTLS_IO_TIMEOUT_MS 5000u
#endif

typedef struct
{
    mbedtls_ssl_context ssl;
    int fd;
    int active;
} mtls_session_t;

int mtls_global_init(void);
int mtls_session_open(mtls_session_t *session, int socket_fd, uint32_t handshake_timeout_ms);
int mtls_read(mtls_session_t *session, void *buf, size_t max_len, uint32_t timeout_ms);
int mtls_read_exact(mtls_session_t *session, void *buf, size_t len, uint32_t timeout_ms);
int mtls_write_all(mtls_session_t *session, const void *buf, size_t len, uint32_t timeout_ms);
void mtls_session_close(mtls_session_t *session);

#ifdef __cplusplus
}
#endif

#endif /* MTLS_SOCKET_H_ */
```

## inc/qa_stream.h
```c
#ifndef QA_STREAM_H_
#define QA_STREAM_H_

#ifndef APP_QA_STREAM
#define APP_QA_STREAM 0
#endif

#if APP_QA_STREAM
void qa_stream_service_start(void);
#else
static inline void qa_stream_service_start(void)
{
}
#endif

#endif /* QA_STREAM_H_ */
```

## inc/runhours_crypto.h
```c
#ifndef RUNHOURS_CRYPTO_H_
#define RUNHOURS_CRYPTO_H_

#include <stddef.h>
#include <stdint.h>

#include "runhours_format.h"

int rh_crypto_init(const uint8_t *device_uuid16);
int rh_crypto_init_v1_only(const uint8_t *device_uuid16);
int rh_crypto_activate_staged_v2(void);
int rh_crypto_fallback_v1(const uint8_t *device_uuid16);
void rh_crypto_zeroize(void);

uint16_t rh_crypto_key_version(void);
uint16_t rh_crypto_key_id(void);
uint8_t rh_crypto_ks_state(void);
int rh_crypto_is_v2(void);

/*
 * Value-preserving migration. append_same_quanta must write one journal record
 * under the already-activated v2 key with the preserved quanta (seq advances).
 */
int rh_crypto_migrate_to_v2(uint64_t quanta_snap, uint64_t seq_snap,
                            int (*append_same_quanta)(uint64_t quanta, void *ctx), void *ctx);
int rh_crypto_try_commit_if_ready(void);

void rh_nonce_build(uint8_t out12[12], uint64_t sector_gen, uint32_t slot);
void rh_aad_build(uint8_t *out, size_t *out_len, uint64_t seq, uint64_t sector_gen, uint16_t sector_id,
                  uint16_t slot);

int rh_aes_gcm_encrypt(const uint8_t nonce[12], const uint8_t *aad, size_t aad_len, const uint8_t plain[16],
                       uint8_t ct[16], uint8_t tag[16]);
int rh_aes_gcm_decrypt(const uint8_t nonce[12], const uint8_t *aad, size_t aad_len, const uint8_t ct[16],
                       const uint8_t tag[16], uint8_t plain[16]);

uint32_t rh_crc32(const uint8_t *data, size_t len);

#endif /* RUNHOURS_CRYPTO_H_ */
```

## inc/runhours_format.h
```c
/*
 * Running-hours journal on-wire / on-flash format (plan §§7.3–7.5).
 * Host model: tools/runhours_host_model.py must stay in sync.
 */
#ifndef RUNHOURS_FORMAT_H_
#define RUNHOURS_FORMAT_H_

#include <stdint.h>
#include "memory_layout.h"

#define RH_SECTOR_SIZE           (8192u)
#define RH_PHRASE_SIZE           (16u)
#define RH_HEADER_SIZE           (64u)
#define RH_RECORD_SIZE           (64u)
#define RH_SLOTS_PER_SECTOR      ((RH_SECTOR_SIZE - RH_HEADER_SIZE) / RH_RECORD_SIZE) /* 127 */
#define RH_SECTOR_COUNT          (16u)
#define RH_POOL_A_SECTORS        (8u)
#define RH_POOL_B_SECTORS        (8u)

#define RH_MAGIC_HDR             (0x31534852u) /* 'RHS1' */
#define RH_MAGIC_REC             (0x31524852u) /* 'RHR1' */
#define RH_COMMIT_MAGIC          (0x54494D4D4F430001ull)
#define RH_FORMAT_VER            (1u)
#define RH_RECORD_TYPE           (1u)
#define RH_QUANTUM_SECONDS       (600u)
/* Persisted run-hours accounting quantum (production): 600 s = 10 minutes.
 * Background task cadence uses the same interval. Not a 15-minute quantum. */

/* Exactly 16 bytes — matches host READY_MARK b"READY_MARKER_v1\\0" */
static const uint8_t RH_READY_MARKER_BYTES[16] = {'R', 'E', 'A', 'D', 'Y', '_', 'M', 'A',
                                                    'R', 'K', 'E', 'R', '_', 'v', '1', 0};

#if defined(APP_FLASH_LAYOUT_512K)
_Static_assert(ML_RUNHOURS_POOL_A_SZ == (RH_POOL_A_SECTORS * RH_SECTOR_SIZE), "pool A");
_Static_assert(ML_RUNHOURS_POOL_B_SZ == (RH_POOL_B_SECTORS * RH_SECTOR_SIZE), "pool B");
_Static_assert(ML_RUNHOURS_TOTAL_SZ == (RH_SECTOR_COUNT * RH_SECTOR_SIZE), "128KiB");
_Static_assert(APP_SLOT_SIZE == 0x00080000u, "512KiB slots");
_Static_assert(APP_SLOT_SIZE + ML_PLATFORM_RESERVE_A_SZ + ML_RUNHOURS_POOL_A_SZ + ML_EVENT_LOG_POOL_A_SZ ==
                   0x00100000u,
               "bank0 map");
#endif

typedef struct {
    uint64_t seq;
    uint64_t quanta;
    uint32_t write_count;
    uint32_t erase_count;
    uint32_t auth_fail;
    uint32_t torn_recoveries;
    uint32_t flash_errors;
    uint32_t crypto_errors;
    uint32_t deferred_ota;
    uint16_t active_sector;
    uint8_t  remap_active;
    uint8_t  provisioned;
    uint8_t  key_version; /* 1=legacy HMAC, 2=ELS opaque */
    uint8_t  key_ks_state; /* rh_ks_state_t */
    uint16_t key_id;
} rh_diag_t;

#endif /* RUNHOURS_FORMAT_H_ */
```

## inc/runhours_journal.h
```c
/*
 * Encrypted running-hours journal API (plan M3/M4 / Gate 10).
 */
#ifndef RUNHOURS_JOURNAL_H_
#define RUNHOURS_JOURNAL_H_

#include <stdint.h>
#include "runhours_format.h"

typedef enum {
    RH_OK = 0,
    RH_ERR_CORRUPT = -1,
    RH_ERR_IO = -2,
    RH_ERR_FULL = -3,
    RH_ERR_BUSY = -4,
    RH_ERR_NOT_PROVISIONED = -5
} rh_status_t;

/* Fault-injection stages for HW power-cut / reset campaign (busy-wait until reset). */
typedef enum {
    RH_FAULT_NONE = 0,
    RH_FAULT_BEFORE_RECORD,
    RH_FAULT_DURING_PHRASE0,
    RH_FAULT_DURING_PHRASE1,
    RH_FAULT_DURING_PHRASE2,
    RH_FAULT_BEFORE_COMMIT,
    RH_FAULT_AFTER_COMMIT,
    RH_FAULT_DURING_ERASE,
    RH_FAULT_BEFORE_READY,
    RH_FAULT_AFTER_READY_BEFORE_CKPT,
    RH_FAULT_AFTER_CHECKPOINT
} rh_fault_stage_t;

rh_status_t rh_journal_init(void);
rh_status_t rh_journal_get_quanta(uint64_t *out_quanta);
rh_status_t rh_journal_append_quanta(uint64_t quanta);
uint64_t rh_journal_seconds(void);
void rh_journal_get_diag(rh_diag_t *out);

/* Qualification helpers (Hello commands). */
rh_status_t rh_journal_force_next_quantum(void);
void rh_journal_arm_fault(rh_fault_stage_t stage);
rh_fault_stage_t rh_journal_fault_armed(void);
/* Qual only: erase all journal sectors and re-init virgin INITIAL record. */
rh_status_t rh_journal_wipe_and_init(void);

#endif /* RUNHOURS_JOURNAL_H_ */
```
